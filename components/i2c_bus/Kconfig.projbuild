## components/i2c_bus/Kconfig.projbuild
```kconfig
menu "I2C Configuration"

    config I2C_SCL
        int "SCL GPIO Num"
        default 23 if IDF_TARGET_ESP32
        default 4
        help
            GPIO number for I2C Master clock line.

    config I2C_SDA
        int "SDA GPIO Num"
        default 22 if IDF_TARGET_ESP32
        default 5
        help
            GPIO number for I2C Master data line.

endmenu
```

## sdkconfig.defaults
```kconfig
CONFIG_ESPTOOLPY_FLASHSIZE_4MB=y
# for the huzzah32
CONFIG_MAGNETO_SENSOR_I2C_SCL=22
CONFIG_MAGNETO_SENSOR_I2C_SDA=23
```

## test/sdkconfig.defaults
```kconfig
CONFIG_ESPTOOLPY_FLASHSIZE_4MB=y
CONFIG_ESP_TASK_WDT_EN=n

# for the huzzah32
CONFIG_I2C_SCL=22
CONFIG_I2C_SDA=23

CONFIG_ESP_MAIN_TASK_STACK_SIZE=8192
```
